## 01_Source/test/b_vexriscv_main_20261013/work_B/firmware/linux_wifi/direct_route/esp32/sdkconfig.defaults
```kconfig
CONFIG_IDF_TARGET="esp32c3"
CONFIG_EPPP_LINK_DEVICE_UART=y
CONFIG_EPPP_LINK_USES_PPP=y
CONFIG_EPPP_LINK_CONN_MAX_RETRY=2147483647
CONFIG_LWIP_PPP_SUPPORT=y
CONFIG_LWIP_PPP_SERVER_SUPPORT=y
CONFIG_LWIP_PPP_NOTIFY_PHASE_SUPPORT=y
CONFIG_LWIP_IPV6=n
CONFIG_LWIP_TCPIP_TASK_STACK_SIZE=4096
CONFIG_ESP_MAIN_TASK_STACK_SIZE=4096
CONFIG_ESP_CONSOLE_UART_DEFAULT=y
CONFIG_ESP_CONSOLE_UART_BAUDRATE=115200
CONFIG_ESPTOOLPY_FLASHSIZE_4MB=y
CONFIG_PARTITION_TABLE_SINGLE_APP_LARGE=y
CONFIG_LWIP_MAX_SOCKETS=12

CONFIG_LWIP_IP_FORWARD=y

CONFIG_LWIP_IPV4_NAPT=y

# CONFIG_LWIP_PPP_VJ_HEADER_COMPRESSION is not set

CONFIG_LWIP_STATS=y
```

## 01_Source/test/b_vexriscv_main_20261013/work_B/firmware/linux_wifi/esp32/sdkconfig.defaults
```kconfig
CONFIG_IDF_TARGET="esp32c3"
CONFIG_EPPP_LINK_DEVICE_UART=y
CONFIG_EPPP_LINK_USES_PPP=y
CONFIG_EPPP_LINK_CONN_MAX_RETRY=2147483647
CONFIG_LWIP_PPP_SUPPORT=y
CONFIG_LWIP_PPP_SERVER_SUPPORT=y
CONFIG_LWIP_PPP_NOTIFY_PHASE_SUPPORT=y
CONFIG_LWIP_IPV6=n
CONFIG_LWIP_TCPIP_TASK_STACK_SIZE=4096
CONFIG_ESP_MAIN_TASK_STACK_SIZE=4096
CONFIG_ESP_CONSOLE_UART_DEFAULT=y
CONFIG_ESP_CONSOLE_UART_BAUDRATE=115200
CONFIG_ESPTOOLPY_FLASHSIZE_4MB=y
CONFIG_PARTITION_TABLE_SINGLE_APP_LARGE=y
CONFIG_LWIP_MAX_SOCKETS=12
```
