// Change Log: 2026-10-02 Codex v2.0 Stereo stage 2 sync/source/bbox metadata.
// -----------------------------------------------------------------------------
// File   : video_udp_rx.v
// Author : OpenAI Codex
// Date   : 2026-09-20
// -----------------------------------------------------------------------------
// Description:
//   Receive the packet format generated by video_udp_tx, validate and reassemble
//   one 160x120 RGB888 frame, then cross framed pixel tokens from the 125 MHz
//   UDP clock domain to an application pixel clock domain.
// -----------------------------------------------------------------------------

`resetall
`timescale 1ns / 1ps
`default_nettype none

module video_udp_rx #
(
    parameter FIFO_ADDR_WIDTH = 12,
    parameter [15:0] EXPECTED_SOURCE_PORT = 16'd6002
)
(
    input  wire        clk_udp,
    input  wire        rst_udp,
    input  wire        udp_rx_valid_i,
    input  wire [7:0]  udp_rx_data_i,
    input  wire [15:0] udp_rx_length_i,
    input  wire [15:0] udp_rx_src_port_i,

    input  wire        clk_pixel,
    input  wire        rst_pixel,
    output reg         frame_start_o,
    output reg         pixel_valid_o,
    output reg  [23:0] pixel_rgb_o,
    output reg         frame_end_o,
    output reg         frame_abort_o,
    output wire [15:0] frame_id_o,
    output wire [15:0] sync_id_o,
    output wire        sync_valid_o,
    output wire [15:0] source_frame_id_o,
    output wire        bbox_valid_o,
    output wire [7:0]  bbox_x1_o,
    output wire [6:0]  bbox_y1_o,
    output wire [7:0]  bbox_x2_o,
    output wire [6:0]  bbox_y2_o,
    output wire        bbox_source_valid_o,
    output wire [15:0] bbox_source_frame_id_o,
    output wire [15:0] bbox_result_id_o,


    output wire        fifo_overflow_o,
    output wire        fifo_underflow_o,
    output wire        packet_error_o,
    output wire        frame_drop_o,
    output wire [15:0] completed_frame_id_o,
    output wire [15:0] completed_frame_count_o
);

    localparam [1:0]
        TOKEN_START = 2'b00,
        TOKEN_PIXEL = 2'b01,
        TOKEN_END   = 2'b10,
        TOKEN_ABORT = 2'b11;

    localparam [14:0] FRAME_PIXELS = 15'd19200;
    localparam [15:0] FULL_IMAGE_BYTES = 16'd1392;
    localparam [15:0] LAST_IMAGE_BYTES = 16'd528;
    localparam [15:0] FULL_UDP_BYTES = 16'd1416;
    localparam [15:0] LAST_UDP_BYTES = 16'd552;
    localparam [15:0] LAST_PACKET_ID = 16'd41;

    reg [25:0] fifo_write_data_reg = 26'd0;
    reg        fifo_write_enable_reg = 1'b0;
    wire       fifo_write_full;
    wire       fifo_write_almost_full;
    wire       fifo_write_overflow;
    // Register FIFO-space status before it enters the 125 MHz packet parser.
    // Eight reserved entries absorb the extra status cycle safely.
    reg        fifo_not_full_reg = 1'b0;
    reg        fifo_payload_space_reg = 1'b0;

    wire [25:0] fifo_read_data;
    wire        fifo_read_enable;
    wire        fifo_read_valid;
    wire        fifo_read_empty;
    wire        fifo_read_underflow;

    reg         udp_rx_valid_d_reg = 1'b0;
    reg [15:0]  udp_byte_count_reg = 16'd0;
    // Calculated at packet start so packet-end control does not contain a
    // 16-bit subtraction.
    reg [15:0]  udp_last_index_reg = 16'd0;
    reg [15:0]  header_frame_id_reg = 16'd0;
    reg [15:0]  header_packet_id_reg = 16'd0;
    reg [15:0]  header_image_bytes_reg = 16'd0;
    reg [7:0]   header_flags_reg = 8'd0;
    reg         packet_accept_reg = 1'b0;
    reg [15:0]  image_byte_count_reg = 16'd0;
    reg [1:0]   color_phase_reg = 2'd0;
    reg [7:0]   red_reg = 8'd0;
    reg [7:0]   green_reg = 8'd0;

    reg         frame_active_reg = 1'b0;
    reg [15:0]  active_frame_id_reg = 16'd0;
    reg [15:0]  expected_packet_id_reg = 16'd0;
    reg         pending_abort_reg = 1'b0;
    reg         pending_end_reg = 1'b0;
    reg         packet_error_reg = 1'b0;
    reg         frame_drop_reg = 1'b0;

    reg         pixel_frame_active_reg = 1'b0;
    reg [14:0]  pixel_count_reg = 15'd0;
    reg [15:0]  pixel_frame_id_reg = 16'd0;
    reg [15:0]  completed_frame_id_reg = 16'd0;
    reg [15:0]  completed_frame_count_reg = 16'd0;

    reg [7:0] header_version_reg = 8'd0;
    reg [127:0] header_metadata_reg = 128'd0;
    reg [127:0] active_metadata_reg = 128'd0;
    reg [127:0] pixel_metadata_reg = 128'd0;
    reg [127:0] metadata_write_reg = 128'd0;
    reg metadata_write_enable_reg = 1'b0;
    reg metadata_read_enable_reg = 1'b0;
    reg pixel_wait_metadata_reg = 1'b0;
    reg pixel_read_pending_reg = 1'b0;
    wire metadata_full;
    wire metadata_read_valid;
    wire [127:0] metadata_read_data;
    wire [127:0] header_metadata = {header_metadata_reg[119:0], udp_rx_data_i};
    wire metadata_syntax_valid =
        header_metadata[111:104] <= 8'd1 &&
        header_metadata[95:88] <= 8'd119 &&
        header_metadata[79:72] <= 8'd119 &&
        header_metadata[103:96] <= 8'd159 &&
        header_metadata[87:80] <= 8'd159 &&
        header_metadata[71:66] == 6'd0 && header_metadata[15:0] == 16'd0 &&
        (!header_metadata[104] || (header_metadata[65] &&
            header_metadata[103:96] <= header_metadata[87:80] &&
            header_metadata[95:88] <= header_metadata[79:72]));
    stereo_metadata_fifo metadata_fifo_inst (
        .clk_write (clk_udp), .rst_write (rst_udp),
        .clk_read (clk_pixel), .rst_read (rst_pixel),
        .write_data_i (metadata_write_reg),
        .write_enable_i (metadata_write_enable_reg),
        .write_full_o (metadata_full), .write_almost_full_o (),
        .write_level_o (), .write_overflow_o (),
        .read_data_o (metadata_read_data),
        .read_enable_i (metadata_read_enable_reg),
        .read_valid_o (metadata_read_valid), .read_empty_o (),
        .read_level_o (), .read_underflow_o ()
    );
    assign frame_id_o = pixel_frame_id_reg;
    assign sync_id_o = pixel_metadata_reg[127:112];
    assign sync_valid_o = pixel_metadata_reg[64];
    assign source_frame_id_o = pixel_metadata_reg[63:48];
    assign bbox_valid_o = pixel_metadata_reg[104];
    assign bbox_x1_o = pixel_metadata_reg[103:96];
    assign bbox_y1_o = pixel_metadata_reg[94:88];
    assign bbox_x2_o = pixel_metadata_reg[87:80];
    assign bbox_y2_o = pixel_metadata_reg[78:72];
    assign bbox_source_valid_o = pixel_metadata_reg[65];
    assign bbox_source_frame_id_o = pixel_metadata_reg[47:32];
    assign bbox_result_id_o = pixel_metadata_reg[31:16];
    wire [1:0]  fifo_token_type = fifo_read_data[25:24];
    wire [23:0] fifo_token_payload = fifo_read_data[23:0];
    wire [15:0] expected_image_bytes =
        (header_packet_id_reg == LAST_PACKET_ID)
            ? LAST_IMAGE_BYTES : FULL_IMAGE_BYTES;
    wire [15:0] expected_udp_bytes =
        (header_packet_id_reg == LAST_PACKET_ID)
            ? LAST_UDP_BYTES : FULL_UDP_BYTES;
    wire [7:0] expected_flags =
        (header_packet_id_reg == 16'd0) ? 8'h01 :
        ((header_packet_id_reg == LAST_PACKET_ID) ? 8'h02 : 8'h00);
    wire header_common_valid =
        (header_packet_id_reg <= LAST_PACKET_ID)
        && (header_image_bytes_reg == expected_image_bytes)
        && (udp_rx_length_i == expected_udp_bytes)
        && (header_flags_reg == expected_flags)
        && (udp_rx_src_port_i == EXPECTED_SOURCE_PORT)
        && (header_version_reg == 8'h02)
        && metadata_syntax_valid;
    wire header_sequence_valid =
        (header_packet_id_reg == 16'd0)
        || (frame_active_reg
            && (header_frame_id_reg == active_frame_id_reg)
            && (header_packet_id_reg == expected_packet_id_reg)
            && (header_metadata == active_metadata_reg));

    assign fifo_overflow_o = fifo_write_overflow;
    assign fifo_underflow_o = fifo_read_underflow;
    assign packet_error_o = packet_error_reg;
    assign frame_drop_o = frame_drop_reg;
    assign completed_frame_id_o = completed_frame_id_reg;
    assign completed_frame_count_o = completed_frame_count_reg;
    // Allow one outstanding RGB token read so START can pause for metadata.
    // Gating the
    // request with empty also prevents a speculative read from underflowing.
    assign fifo_read_enable = !fifo_read_empty &&
        !pixel_read_pending_reg && !pixel_wait_metadata_reg;

    video_udp_async_fifo #(
        .DATA_WIDTH          (26),
        .ADDR_WIDTH          (FIFO_ADDR_WIDTH),
        .ALMOST_FULL_MARGIN  (8)
    ) video_udp_async_fifo_inst (
        .clk_write           (clk_udp),
        .rst_write           (rst_udp),
        .clk_read            (clk_pixel),
        .rst_read            (rst_pixel),
        .write_data_i        (fifo_write_data_reg),
        .write_enable_i      (fifo_write_enable_reg),
        .write_full_o        (fifo_write_full),
        .write_almost_full_o (fifo_write_almost_full),
        .write_level_o       (),
        .write_overflow_o    (fifo_write_overflow),
        .read_data_o         (fifo_read_data),
        .read_enable_i       (fifo_read_enable),
        .read_valid_o        (fifo_read_valid),
        .read_empty_o        (fifo_read_empty),
        .read_level_o        (),
        .read_underflow_o    (fifo_read_underflow)
    );

    // UDP-domain packet parser and frame sequence checker.
    always @(posedge clk_udp) begin
        fifo_write_enable_reg <= 1'b0;
        metadata_write_enable_reg <= 1'b0;
        packet_error_reg      <= 1'b0;
        frame_drop_reg        <= 1'b0;
        udp_rx_valid_d_reg    <= udp_rx_valid_i;
        fifo_not_full_reg     <= !fifo_write_full;
        fifo_payload_space_reg <=
            !fifo_write_full && !fifo_write_almost_full;

        // Abort/end markers are emitted in the inter-packet gap.  Ethernet
        // guarantees a gap much longer than one user clock at 1 Gb/s.
        if (pending_abort_reg && fifo_not_full_reg) begin
            fifo_write_enable_reg <= 1'b1;
            fifo_write_data_reg   <= {TOKEN_ABORT, 24'd0};
            pending_abort_reg     <= 1'b0;
        end else if (pending_end_reg && fifo_not_full_reg) begin
            fifo_write_enable_reg <= 1'b1;
            fifo_write_data_reg   <= {TOKEN_END, 24'd0};
            pending_end_reg       <= 1'b0;
        end

        if (udp_rx_valid_i) begin
            udp_byte_count_reg <= udp_byte_count_reg + 16'd1;
            case (udp_byte_count_reg)
                16'd0: begin
                    header_frame_id_reg[15:8] <= udp_rx_data_i;
                    udp_last_index_reg <= udp_rx_length_i - 16'd1;
                end
                16'd1: header_frame_id_reg[7:0] <= udp_rx_data_i;
                16'd2: header_packet_id_reg[15:8] <= udp_rx_data_i;
                16'd3: header_packet_id_reg[7:0] <= udp_rx_data_i;
                16'd4: header_image_bytes_reg[15:8] <= udp_rx_data_i;
                16'd5: header_image_bytes_reg[7:0] <= udp_rx_data_i;
                16'd6: header_flags_reg <= udp_rx_data_i;
                16'd7: header_version_reg <= udp_rx_data_i;
                16'd23: begin
                    packet_accept_reg    <= 1'b0;
                    image_byte_count_reg <= 16'd0;
                    color_phase_reg      <= 2'd0;

                    if (header_common_valid && header_sequence_valid
                        && !pending_abort_reg && !pending_end_reg) begin
                        if (header_packet_id_reg == 16'd0) begin
                            if (fifo_payload_space_reg && !metadata_full) begin
                                active_metadata_reg <= header_metadata;
                                metadata_write_reg <= header_metadata;
                                metadata_write_enable_reg <= 1'b1;
                                fifo_write_enable_reg <= 1'b1;
                                fifo_write_data_reg <=
                                    {TOKEN_START, 8'd0, header_frame_id_reg};
                                packet_accept_reg <= 1'b1;
                                frame_active_reg <= 1'b1;
                                active_frame_id_reg <= header_frame_id_reg;
                                expected_packet_id_reg <= 16'd0;
                                if (frame_active_reg) begin
                                    frame_drop_reg <= 1'b1;
                                end
                            end else begin
                                frame_active_reg <= 1'b0;
                                frame_drop_reg <= 1'b1;
                                packet_error_reg <= 1'b1;
                            end
                        end else begin
                            packet_accept_reg <= 1'b1;
                        end
                    end else begin
                        packet_error_reg <= 1'b1;
                        if (frame_active_reg) begin
                            frame_active_reg <= 1'b0;
                            pending_abort_reg <= 1'b1;
                            frame_drop_reg <= 1'b1;
                        end
                    end
                end
                default: begin
                    if (udp_byte_count_reg >= 16'd8 && udp_byte_count_reg < 16'd23) begin
                        header_metadata_reg <= {header_metadata_reg[119:0], udp_rx_data_i};
                    end else if (packet_accept_reg) begin
                        image_byte_count_reg <= image_byte_count_reg + 16'd1;
                        case (color_phase_reg)
                            2'd0: begin
                                red_reg <= udp_rx_data_i;
                                color_phase_reg <= 2'd1;
                            end
                            2'd1: begin
                                green_reg <= udp_rx_data_i;
                                color_phase_reg <= 2'd2;
                            end
                            default: begin
                                if (fifo_payload_space_reg) begin
                                    fifo_write_enable_reg <= 1'b1;
                                    fifo_write_data_reg <=
                                        {TOKEN_PIXEL, red_reg,
                                         green_reg, udp_rx_data_i};
                                    color_phase_reg <= 2'd0;
                                end else begin
                                    packet_accept_reg <= 1'b0;
                                    frame_active_reg <= 1'b0;
                                    pending_abort_reg <= 1'b1;
                                    packet_error_reg <= 1'b1;
                                    frame_drop_reg <= 1'b1;
                                end
                            end
                        endcase

                        if (udp_byte_count_reg == udp_last_index_reg) begin
                            packet_accept_reg <= 1'b0;
                            if ((image_byte_count_reg
                                 == header_image_bytes_reg - 16'd1)
                                && (color_phase_reg == 2'd2)
                                && fifo_payload_space_reg) begin
                                if (header_packet_id_reg
                                    == LAST_PACKET_ID) begin
                                    pending_end_reg <= 1'b1;
                                    frame_active_reg <= 1'b0;
                                end else begin
                                    expected_packet_id_reg <=
                                        header_packet_id_reg + 16'd1;
                                end
                            end else begin
                                frame_active_reg <= 1'b0;
                                pending_abort_reg <= 1'b1;
                                packet_error_reg <= 1'b1;
                                frame_drop_reg <= 1'b1;
                            end
                        end
                    end
                end
            endcase
        end else begin
            udp_byte_count_reg <= 16'd0;
            if (udp_rx_valid_d_reg && packet_accept_reg) begin
                packet_accept_reg <= 1'b0;
                frame_active_reg <= 1'b0;
                pending_abort_reg <= 1'b1;
                packet_error_reg <= 1'b1;
                frame_drop_reg <= 1'b1;
            end
        end

        if (rst_udp) begin
            header_version_reg <= 8'd0;
            header_metadata_reg <= 128'd0;
            active_metadata_reg <= 128'd0;
            metadata_write_reg <= 128'd0;
            metadata_write_enable_reg <= 1'b0;
            fifo_write_data_reg       <= 26'd0;
            fifo_write_enable_reg     <= 1'b0;
            udp_rx_valid_d_reg        <= 1'b0;
            udp_byte_count_reg        <= 16'd0;
            udp_last_index_reg        <= 16'd0;
            header_frame_id_reg       <= 16'd0;
            header_packet_id_reg      <= 16'd0;
            header_image_bytes_reg    <= 16'd0;
            header_flags_reg          <= 8'd0;
            packet_accept_reg         <= 1'b0;
            image_byte_count_reg      <= 16'd0;
            color_phase_reg           <= 2'd0;
            red_reg                   <= 8'd0;
            green_reg                 <= 8'd0;
            frame_active_reg          <= 1'b0;
            active_frame_id_reg       <= 16'd0;
            expected_packet_id_reg    <= 16'd0;
            pending_abort_reg         <= 1'b0;
            pending_end_reg           <= 1'b0;
            packet_error_reg          <= 1'b0;
            frame_drop_reg            <= 1'b0;
            fifo_not_full_reg         <= 1'b0;
            fifo_payload_space_reg    <= 1'b0;
        end
    end

    // Pixel-domain token reader.  START and END delimit only complete frames;
    // malformed or dropped network frames terminate with ABORT.
    always @(posedge clk_pixel) begin
        frame_start_o <= 1'b0;
        pixel_valid_o <= 1'b0;
        frame_end_o   <= 1'b0;
        frame_abort_o <= 1'b0;
        metadata_read_enable_reg <= 1'b0;
        if (fifo_read_enable) pixel_read_pending_reg <= 1'b1;
        if (metadata_read_valid && pixel_wait_metadata_reg) begin
            pixel_metadata_reg <= metadata_read_data;
            pixel_wait_metadata_reg <= 1'b0;
            pixel_frame_active_reg <= 1'b1;
            frame_start_o <= 1'b1;
        end

        if (fifo_read_valid) begin
            pixel_read_pending_reg <= 1'b0;
            case (fifo_token_type)
                TOKEN_START: begin
                    if (pixel_frame_active_reg) begin
                        frame_abort_o <= 1'b1;
                    end
                    pixel_frame_active_reg <= 1'b0;
                    pixel_wait_metadata_reg <= 1'b1;
                    metadata_read_enable_reg <= 1'b1;
                    pixel_count_reg <= 15'd0;
                    pixel_frame_id_reg <= fifo_token_payload[15:0];
                    // SOF follows paired metadata acknowledgment.
                end
                TOKEN_PIXEL: begin
                    if (pixel_frame_active_reg
                        && (pixel_count_reg < FRAME_PIXELS)) begin
                        pixel_rgb_o <= fifo_token_payload;
                        pixel_valid_o <= 1'b1;
                        pixel_count_reg <= pixel_count_reg + 15'd1;
                    end else begin
                        pixel_frame_active_reg <= 1'b0;
                        frame_abort_o <= 1'b1;
                    end
                end
                TOKEN_END: begin
                    if (pixel_frame_active_reg
                        && (pixel_count_reg == FRAME_PIXELS)) begin
                        frame_end_o <= 1'b1;
                        completed_frame_id_reg <= pixel_frame_id_reg;
                        completed_frame_count_reg <=
                            completed_frame_count_reg + 16'd1;
                    end else begin
                        frame_abort_o <= 1'b1;
                    end
                    pixel_frame_active_reg <= 1'b0;
                end
                default: begin
                    if (pixel_frame_active_reg) begin
                        frame_abort_o <= 1'b1;
                    end
                    pixel_frame_active_reg <= 1'b0;
                end
            endcase
        end

        if (rst_pixel) begin
            pixel_metadata_reg <= 128'd0;
            metadata_read_enable_reg <= 1'b0;
            pixel_wait_metadata_reg <= 1'b0;
            pixel_read_pending_reg <= 1'b0;
            pixel_frame_active_reg     <= 1'b0;
            pixel_count_reg            <= 15'd0;
            pixel_frame_id_reg         <= 16'd0;
            completed_frame_id_reg     <= 16'd0;
            completed_frame_count_reg  <= 16'd0;
            frame_start_o              <= 1'b0;
            pixel_valid_o              <= 1'b0;
            pixel_rgb_o                <= 24'd0;
            frame_end_o                <= 1'b0;
            frame_abort_o              <= 1'b0;
        end
    end

endmodule

`resetall
